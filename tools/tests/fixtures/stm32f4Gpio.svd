# stm32f4Gpio register map
Registers are 32-bit, access not given, reset 0x0 unless marked. A register's access mark holds for its fields unless they carry their own. Offsets are from the block's base; lines under a group give offsets from that group; [hi:lo] are bit positions; {n}, {i} and the like mark numbered series; 'fields as' and 'values as' point back to an identical list; <NAME> marks a mode.

## Memory map
0x40020000 GPIOA
0x40020400 GPIOB

## GPIOA
Base 0x40020000
0x00 MODER reset 0xA8000000
0x10 IDR
0x14 ODR
  [5] OD5
0x18 BSRR
